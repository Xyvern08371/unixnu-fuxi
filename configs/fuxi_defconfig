## configs/fuxi_ramroot_defconfig
```kconfig
# Mount-only RAM root diagnostic. No physical storage or userland.
CONFIG_XNU_SOURCE_CORECRYPTO14=y
CONFIG_XNU_SOURCE_PTHREAD=y
CONFIG_XNU_ARM_DT_PLATFORM=y
CONFIG_XNU_ARMCPU=y
CONFIG_XNU_NATIVE_AES=y
CONFIG_XNU_TRUST_CACHE_RUNTIME=y
CONFIG_XNU_DT_PANIC_REGION=y
CONFIG_XNU_NATIVE_ARCH_TIMER=y
CONFIG_XNU_NATIVE_PAN=y
CONFIG_XNU_SHENG_PMGR=y
CONFIG_XNU_RAM_ROOT_PROBE=y
CONFIG_XNU_NATIVE_UFS=n
CONFIG_XNU_NATIVE_RAM_BLOCK=n
CONFIG_XNU_VERIFIED_ROOT_PROBE=n
CONFIG_XNU_CRYPTO_BOOTSTRAP="prelinked"
CONFIG_XNU_EXTRA_LD_ARCHIVES="{tree}/build/legacy-stub/libLegacyStub.a"
```
